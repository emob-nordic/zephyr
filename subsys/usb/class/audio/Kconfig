## subsys/usb/class/audio/Kconfig
```kconfig
# USB AUDIO configuration options

# Copyright (c) 2020 Nordic Semiconductor ASA
# SPDX-License-Identifier: Apache-2.0

config USB_DEVICE_AUDIO
	bool "USB Audio Device Class Driver"
	help
	  USB audio device class driver.
	  Device configuration is done via dt overlay.

if USB_DEVICE_AUDIO

module = USB_AUDIO
module-str = USB Audio
source "subsys/logging/Kconfig.template.log_config"

endif #USB_DEVICE_AUDIO
```
